## drivers/soc/oplus/dfr/Kconfig
```kconfig
# SPDX-License-Identifier: GPL-2.0-only
# Copyright (C) 2018-2022 Oplus. All rights reserved.

#ifdef OPLUS_FEATURE_PMIC_MONITOR
source "drivers/soc/oplus/dfr/qcom/qcom_pmic_monitor/Kconfig"
#endif /* OPLUS_FEATURE_PMIC_MONITOR */

#ifdef OPLUS_FEATURE_FORCE_SHUTDOWN
source "drivers/soc/oplus/dfr/qcom/force_shutdown/Kconfig"
#endif /* OPLUS_FEATURE_FORCE_SHUTDOWN */

#ifdef OPLUS_FEATURE_QCOM_PMICWD
source "drivers/soc/oplus/dfr/qcom/qcom_pmicwd/Kconfig"
#endif /* OPLUS_FEATURE_QCOM_PMICWD */

#ifdef OPLUS_FEATURE_QCOM_WATCHDOG
source "drivers/soc/oplus/dfr/qcom/qcom_watchdog/Kconfig"
#endif /* OPLUS_FEATURE_QCOM_WATCHDOG */

#ifdef OPLUS_FEATURE_DUMP_REASON
source "drivers/soc/oplus/dfr/qcom/dump_device_info/Kconfig"
#endif /* OPLUS_FEATURE_DUMP_REASON */

#ifdef OPLUS_FEATURE_DUMP_REASON
source "drivers/soc/oplus/dfr/qcom/dump_reason/Kconfig"
#endif /* OPLUS_FEATURE_DUMP_REASON */
#ifdef OPLUS_FEATURE_SHUTDOWN_DETECT
source "drivers/soc/oplus/dfr/common/shutdown_detect/Kconfig"
#endif /* OPLUS_FEATURE_SHUTDOWN_DETECT */

#ifdef OPLUS_FEATURE_HUNG_TASK_ENHANCE
source "drivers/soc/oplus/dfr/common/hung_task_enhance/Kconfig"
#endif /* OPLUS_FEATURE_HUNG_TASK_ENHANCE */

#ifdef OPLUS_FEATURE_INIT_WATCHDOG
source "drivers/soc/oplus/dfr/common/init_watchdog/Kconfig"
#endif /* OPLUS_FEATURE_INIT_WATCHDOG */

#ifdef OPLUS_FEATURE_LAST_BOOT_REASON
source "drivers/soc/oplus/dfr/common/last_boot_reason/Kconfig"
#endif /*OPLUS_FEATURE_LAST_BOOT_REASON*/
```
