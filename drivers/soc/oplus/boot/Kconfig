## drivers/soc/oplus/boot/Kconfig
```kconfig
# SPDX-License-Identifier: GPL-2.0-only
# Copyright (C) 2018-2022 Oplus. All rights reserved.

#ifdef CONFIG_OPLUS_SYSTEM_KERNEL
config OPLUS_SYSTEM_KERNEL_QCOM
  bool "config oplus system feature "
  default y
  help
	define this config to Distinguish between qcom and mtk platform

#endif

source "drivers/soc/oplus/boot/cmdline_parser/Kconfig"
source "drivers/soc/oplus/boot/oplus_project/Kconfig"
source "drivers/soc/oplus/boot/project_info/Kconfig"
```

## drivers/soc/oplus/boot/cmdline_parser/Kconfig
```kconfig
# SPDX-License-Identifier: GPL-2.0-only
# Copyright (C) 2018-2020 Oplus. All rights reserved.

config OPLUS_FEATURE_CMDLINE
	tristate "Oplus command line"
	default n
	help
	  define this config to get command line.

config OPLUS_FEATURE_CHARGERPRESENT
	tristate "Oplus charger present"
	default n
	help
	  define this config to get charger present cmdline.

config OPLUS_FEATURE_SIMCARDNUM
	tristate "Oplus simcardnum"
	default n
	help
	  define this config to get simcardnum cmdline.
```
